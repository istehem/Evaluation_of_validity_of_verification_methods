AUTOSAR XML (schema 4-0-3)
package /PICEA/BswMd
  bsw module entry Csm_MainFunction: service-id=01, is-synchronous=true, call-type=SCHEDULED, execution-context=TASK, sw-service-impl-policy=STANDARD
  bsw module description Csm: module-id=110  # Crypto Service Manager
    bsw internal behavior BSWBehavior_Csm
      bsw schedulable entity Csm_MainFunction: implemented-entry=Csm_MainFunction
      bsw timing event Evt_Csm_MainFunction: starts-on-event=Csm_MainFunction, period=1000
